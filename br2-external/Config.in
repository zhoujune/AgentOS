## br2-external/configs/agentos_x86_64_defconfig
```kconfig
BR2_x86_64=y
BR2_TOOLCHAIN_BUILDROOT_UCLIBC=y
BR2_PACKAGE_HOST_LINUX_HEADERS_CUSTOM_6_12=y
BR2_TOOLCHAIN_BUILDROOT_WCHAR=y
BR2_PRIMARY_SITE="https://mirrors.tuna.tsinghua.edu.cn/buildroot/"
BR2_ROOTFS_USERS_TABLES="$(BR2_EXTERNAL_AGENTOS_PATH)/board/agentos/x86_64/users_table.txt"
BR2_ROOTFS_OVERLAY="$(BR2_EXTERNAL_AGENTOS_PATH)/board/agentos/x86_64/overlay"
BR2_ROOTFS_POST_BUILD_SCRIPT="$(BR2_EXTERNAL_AGENTOS_PATH)/board/agentos/x86_64/post_build/post_build.sh"
BR2_ROOTFS_POST_FAKEROOT_SCRIPT="$(BR2_EXTERNAL_AGENTOS_PATH)/board/agentos/x86_64/post_build/post_fakeroot.sh"
BR2_ROOTFS_POST_IMAGE_SCRIPT="$(BR2_EXTERNAL_AGENTOS_PATH)/board/agentos/x86_64/post_image/post_image.sh"
BR2_LINUX_KERNEL=y
BR2_LINUX_KERNEL_CUSTOM_VERSION=y
BR2_LINUX_KERNEL_CUSTOM_VERSION_VALUE="6.12.47"
BR2_LINUX_KERNEL_USE_CUSTOM_CONFIG=y
BR2_LINUX_KERNEL_CUSTOM_CONFIG_FILE="$(BR2_EXTERNAL_AGENTOS_PATH)/board/agentos/x86_64/linux.config"
BR2_LINUX_KERNEL_INSTALL_TARGET=y
BR2_PACKAGE_PYTHON3=y

# Network packages
BR2_PACKAGE_IPROUTE2=y
BR2_PACKAGE_UDHCP=y
BR2_PACKAGE_IPUTILS=y
BR2_PACKAGE_CURL=y

BR2_TARGET_ROOTFS_EXT2=y
```

## buildroot-configs/x86_64_minimal_baseline_defconfig
```kconfig
BR2_x86_64=y
BR2_PRIMARY_SITE="https://mirrors.tuna.tsinghua.edu.cn/buildroot/"
BR2_LINUX_KERNEL=y
BR2_LINUX_KERNEL_DEFCONFIG="x86_64"
BR2_TARGET_ROOTFS_ISO9660=y
BR2_TARGET_SYSLINUX=y
```
